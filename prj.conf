## prj.conf
```kconfig
CONFIG_GPIO=y

# nRF board library
CONFIG_DK_LIBRARY=y

# Generic networking options
CONFIG_NETWORKING=y

# Network shell
CONFIG_SHELL=y
CONFIG_SHELL_ARGC_MAX=26
CONFIG_SHELL_CMD_BUFF_SIZE=416

# Network sockets
CONFIG_NET_SOCKETS=y
CONFIG_NET_SOCKETS_POSIX_NAMES=y
CONFIG_NET_SOCKETS_POLL_MAX=4

# Enable Openthread FTD features set
CONFIG_OPENTHREAD=y
CONFIG_OPENTHREAD_THREAD_VERSION_1_3_1=y
CONFIG_OPENTHREAD_FTD=y

# Openthread settings
CONFIG_OPENTHREAD_PANID=4660
CONFIG_OPENTHREAD_CHANNEL=15
CONFIG_OPENTHREAD_NETWORK_NAME="OpenThreadDemo"
CONFIG_OPENTHREAD_NETWORKKEY="00:11:22:33:44:55:66:77:88:99:aa:bb:cc:dd:ee:ff"
CONFIG_OPENTHREAD_XPANID="1111111122222222"

# L2 OpenThread enabling
CONFIG_NET_L2_OPENTHREAD=y
CONFIG_OPENTHREAD_SHELL=y
# CONFIG_IEEE802154_NET_IF_NO_AUTO_START=y

# CONFIG_MBEDTLS_SHA1_C=n
# CONFIG_FPU=y
```

## overlay-logging.conf
```kconfig
#
# Copyright (c) 2022 Nordic Semiconductor
#
# SPDX-License-Identifier: LicenseRef-Nordic-5-Clause

# Enable net module logging
CONFIG_NET_LOG=y
# Option for configuring log level in net config library
CONFIG_NET_CONFIG_LOG_LEVEL_INF=y

# Option for configuring log level in Zephyr L2 logging
CONFIG_OPENTHREAD_L2_DEBUG=y
CONFIG_OPENTHREAD_L2_LOG_LEVEL_DBG=y
CONFIG_OPENTHREAD_L2_DEBUG_DUMP_15_4=y
CONFIG_OPENTHREAD_L2_DEBUG_DUMP_IPV6=y

# Configure sample logging setting
CONFIG_LOG=y
CONFIG_OPENTHREAD_DEBUG=y

# Option for configuring log level in OpenThread
CONFIG_OPENTHREAD_LOG_LEVEL_NOTE=y

# Enable RTT logging backend
CONFIG_USE_SEGGER_RTT=y
CONFIG_LOG_BACKEND_RTT=y

# Disable UART logging backend
CONFIG_LOG_BACKEND_UART=n
CONFIG_SHELL_LOG_BACKEND=n
```

## src/main.c
```c
#include <zephyr/kernel.h>
#include <zephyr/drivers/gpio.h>
#include <openthread/thread.h>
#include <zephyr/net/openthread.h>
#include <zephyr/net/openthread.h>
#include <zephyr/net/socket.h>
#include <zephyr/logging/log.h>
#include <openthread/ip6.h>

/* 1000 msec = 1 sec */
#define SLEEP_TIME_MS 1000

/* The devicetree node identifier for the "led0" alias. */
#define LED0_NODE DT_ALIAS(led0)

LOG_MODULE_REGISTER(blinky);
static const struct gpio_dt_spec led = GPIO_DT_SPEC_GET(LED0_NODE, gpios);

static void on_thread_state_changed(otChangedFlags flags, struct openthread_context *ot_context,
									void *user_data)
{
	if (flags & OT_CHANGED_THREAD_ROLE)
	{
		switch (otThreadGetDeviceRole(ot_context->instance))
		{
		case OT_DEVICE_ROLE_CHILD:
			LOG_INF("OT_DEVICE_ROLE_CHILD");
			break;
		case OT_DEVICE_ROLE_ROUTER:
			LOG_INF("OT_DEVICE_ROLE_ROUTER");
			break;
		case OT_DEVICE_ROLE_LEADER:
			LOG_INF("OT_DEVICE_ROLE_LEADER");
			break;
		case OT_DEVICE_ROLE_DISABLED:
			LOG_INF("OT_DEVICE_ROLE_DISABLED");
			break;
		case OT_DEVICE_ROLE_DETACHED:
			LOG_INF("OT_DEVICE_ROLE_DETACHED");
			break;
		default:
			LOG_INF("OT DEFAULT STATE");
			break;
		}
	}
}
static struct openthread_state_changed_cb ot_state_chaged_cb = {
	.state_changed_cb = on_thread_state_changed};

void register_callback_and_start_thread()
{
	openthread_state_changed_cb_register(openthread_get_default_context(), &ot_state_chaged_cb);
	openthread_start(openthread_get_default_context());
}

void subcribe_multicast_address()
{
	struct openthread_context *ot_context = openthread_get_default_context();

	// subscribe to multicast address in openthread
	struct otIp6Address addr;
	inet_pton(AF_INET6, "ff06::abcd", &addr);
	otIp6SubscribeMulticastAddress(ot_context->instance, &addr);
	struct otIp6Address addr2;
	inet_pton(AF_INET6, "ff07::abcd", &addr2);
	otIp6SubscribeMulticastAddress(ot_context->instance, &addr2);

	// set router eligible to false
	// otThreadSetRouterEligible(ot_context->instance, false);
}

int main(void)
{
	int ret;

	if (!gpio_is_ready_dt(&led))
	{
		return 0;
	}

	ret = gpio_pin_configure_dt(&led, GPIO_OUTPUT_ACTIVE);
	if (ret < 0)
	{
		return 0;
	}

	register_callback_and_start_thread();
	// delay 2s to wait for thread network to be ready
	k_msleep(2000);
	subcribe_multicast_address();

	while (1)
	{
		ret = gpio_pin_toggle_dt(&led);
		if (ret < 0)
		{
			return 0;
		}
		k_msleep(SLEEP_TIME_MS);
	}
	return 0;
}
```
